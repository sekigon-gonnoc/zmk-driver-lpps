
#include <dt-bindings/zmk/behaviors.h>
#include <dt-bindings/zmk/keys.h>

/ {
    behaviors {
        ps_calib: ps_calib {
            compatible = "zmk,behavior-lpps-calibration";
            #binding-cells = <0>;
        };
    };
};