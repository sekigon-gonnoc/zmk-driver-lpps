## Kconfig
```kconfig
menuconfig LPPS
    bool "low power pointing stick"
  select I2C
    help
      Enable LPPS
```

## dts/bindings/behaviors/zmk,behavior-lpps-calibration.yaml
```yaml
description: Mod Morph Behavior

compatible: "zmk,behavior-lpps-calibration"

include: zero_param.yaml
```

## dts/bindings/lpps-calibration.yaml
```yaml
# Copyright 2025 sekigon-gonnoc
# SPDX-License-Identifier: GPL-2.0 or later

description: Low power trackpoint driver

compatible: "lpps"

include: i2c-device.yaml

properties:
  irq-gpios:
    type: phandle-array
    required: true
    description:
      GPIO connected to the motion pin, active low.

  power-gpios:
    type: phandle-array
    required: false
    description:
      GPIO connected to the power control pin.
```
